/*
 * Copyright (c) 2020 Pete Johanson, Kurtis Lew
 *
 * SPDX-License-Identifier: MIT
 */

#include "dactyl_typesafe.dtsi"
#include <dt-bindings/zmk/keys.h>

&kscan0 {
	row-gpios
		= <&pro_micro 0 (GPIO_ACTIVE_HIGH | GPIO_PULL_DOWN)>
		, <&pro_micro 4 (GPIO_ACTIVE_HIGH | GPIO_PULL_DOWN)>
		, <&pro_micro 21 (GPIO_ACTIVE_HIGH | GPIO_PULL_DOWN)>
		, <&pro_micro 18 (GPIO_ACTIVE_HIGH | GPIO_PULL_DOWN)>
		, <&pro_micro 15 (GPIO_ACTIVE_HIGH | GPIO_PULL_DOWN)>
		;
	col-gpios
		= <&pro_micro 2 GPIO_ACTIVE_HIGH>
		, <&pro_micro 3 GPIO_ACTIVE_HIGH>
		, <&pro_micro 5 GPIO_ACTIVE_HIGH>
		, <&pro_micro 6 GPIO_ACTIVE_HIGH>
		, <&pro_micro 7 GPIO_ACTIVE_HIGH>
		, <&pro_micro 8 GPIO_ACTIVE_HIGH>
		;
};


/ {
	joystick_x: joystick_x {
    	compatible = "joystick";
        status = "okay";
        label = "JOYSTICK_X";
		io-channels = <&adc 5>;
		min_on = <200>;
		reverse;
    };
	
	joystick_y: joystick_y {
		compatible = "joystick";
		status = "okay";
		label = "JOYSTICK_Y";
		io-channels = <&adc 0>;
		min_on = <200>;
    };
};
