## app/boards/shields/dactyl_typesafe/Kconfig.defconfig
```kconfig
# Copyright (c) 2020 Pete Johanson, Kurtis Lew
# SPDX-License-Identifier: MIT

if SHIELD_DACTYL_TYPESAFE_LEFT

endif

if SHIELD_DACTYL_TYPESAFE_RIGHT

config ZMK_USB_LOGGING
	default y

config ZMK_KEYBOARD_NAME
	default "DactylTypesafe"

config ZMK_SPLIT_BLE_ROLE_CENTRAL
	default y

config SPI
	default y

config SPI_1
	default y

config ZMK_MOUSE
	default y

config PMW33XX
	default y

endif

if SHIELD_DACTYL_TYPESAFE_LEFT || SHIELD_DACTYL_TYPESAFE_RIGHT

config ZMK_SPLIT
	default y

endif
```

## app/boards/shields/dactyl_typesafe/Kconfig.shield
```kconfig
# Copyright (c) 2020 Pete Johanson, Kurtis Lew
# SPDX-License-Identifier: MIT

config SHIELD_DACTYL_TYPESAFE_LEFT
	def_bool $(shields_list_contains,dactyl_typesafe_left)

config SHIELD_DACTYL_TYPESAFE_RIGHT
	def_bool $(shields_list_contains,dactyl_typesafe_right)
```

## app/dts/bindings/behaviors/zmk,behavior-momentary-layer.yaml
```yaml
# Copyright (c) 2020 The ZMK Contributors
# SPDX-License-Identifier: MIT

description: Momentary layer on press/release behavior

compatible: "zmk,behavior-momentary-layer"

include: two_param.yaml
```

## app/dts/bindings/behaviors/zmk,behavior-pmw33xx.yaml
```yaml
# Copyright (c) 2021 The ZMK Contributors
# SPDX-License-Identifier: MIT

description: Trackball PMW33XX behavior

compatible: "zmk,behavior-pmw33xx"

include: zero_param.yaml

properties:
  mode:
    type: int
    required: true
  momentary:
    type: boolean
```
